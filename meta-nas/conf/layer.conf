## meta-nas/conf/layer.conf
```bitbake
# We have a conf and classes directory, add to BBPATH
BBPATH =. "${LAYERDIR}:"

# We have recipes-* directories, add to BBFILES
BBFILES += "${LAYERDIR}/recipes-*/*/*.bb \
            ${LAYERDIR}/recipes-*/*/*.bbappend"

BBFILE_COLLECTIONS += "nas"
BBFILE_PATTERN_nas= "^${LAYERDIR}/"
BBFILE_PRIORITY_nas= "5"

LAYERSERIES_COMPAT_promise= "rocko"

# This should only be incremented on significant changes that will
# cause compatibility issues with other layers
LAYERVERSION_promise= "3"

LAYERDEPENDS_promise= "core"

REQUIRED_POKY_BBLAYERS_CONF_VERSION = "2"
```
